## dts/bindings/vendor/google-goldfish-rtc.yaml
```yaml
# build/dts/bindings/vendor/google-goldfish-rtc.yaml
compatible: "google,goldfish-rtc"
description: "Google Goldfish RTC controller"

properties:
  reg:
    type: array
    rust:
      - name: "BASE_ADDRESS"
        value: "[0].address"
        ty: "usize"
      - name: "REG_SIZE"
        value: "[0].size"
        ty: "usize"
  interrupts:
    type: array
    rust:
      - name: "IRQ_NUMBER"
        value: "[0]"
        ty: "usize"

cfg-flags:
  - "dt_has_${compatible_label}"
```

## dts/bindings/vendor/ns16550.yaml
```yaml
# build/dts/bindings/vendor/ns16550.yaml
compatible: "ns16550"
description: "NS16550 UART controller"

properties:
  reg:
    type: array
    rust:
      - name: "BASE_ADDRESS"
        value: "[0].address"
        ty: "usize"
      - name: "REG_SIZE"
        value: "[0].size"
        ty: "usize"
  interrupts:
    type: array
    rust:
      - name: "IRQ_NUMBER"
        value: "[0]"
        ty: "usize"
  clock-frequency:
    type: int
    rust:
      - name: "CLOCK_FREQUENCY"
        value: "."
        ty: "u32"

cfg-flags:
  - "dt_has_${compatible_label}"
```

## dts/bindings/vendor/riscv-plic.yaml
```yaml
# build/dts/bindings/vendor/riscv-plic.yaml
compatible: "riscv,plic0"
description: "RISC-V Platform Level Interrupt Controller"

properties:
  reg:
    type: array
    rust:
      - name: "BASE_ADDRESS"
        value: "[0].address"
        ty: "usize"
      - name: "REG_SIZE"
        value: "[0].size"
        ty: "usize"
  riscv,max-priority:
    type: int
    rust:
      - name: "MAX_PRIORITY"
        value: "."
        ty: "u32"
  riscv,ndev:
    type: int
    rust:
      - name: "NUM_SOURCES"
        value: "."
        ty: "u32"

cfg-flags:
  - "dt_has_${compatible_label}"
```
